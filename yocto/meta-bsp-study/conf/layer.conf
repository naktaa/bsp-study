## yocto/meta-bsp-study/conf/layer.conf
```bitbake
BBPATH .= ":${LAYERDIR}"

BBFILES += "${LAYERDIR}/recipes*/*/*.bb \
            ${LAYERDIR}/recipes*/*/*.bbappend"

BBFILE_COLLECTIONS += "bsp-study"
BBFILE_PATTERN_bsp-study := "^${LAYERDIR}/"
BBFILE_PRIORITY_bsp-study = "9"

LAYERSERIES_COMPAT_bsp-study = "scarthgap"
LAYERDEPENDS_bsp-study = "core raspberrypi"
```
